## Kconfig
```
# Copyright (c) {% now 'utc', '%Y' %} {{cookiecutter.project_org}}
# Copyright (c) 2021 Nordic Semiconductor ASA
# SPDX-License-Identifier: Apache-2.0
#
# This file is the application Kconfig entry point. All application Kconfig
# options can be defined here or included via other application Kconfig files.
# You can browse these options using the west targets menuconfig (terminal) or
# guiconfig (GUI).

menu "Zephyr"
source "Kconfig.zephyr"
endmenu

module = APP
module-str = APP
source "subsys/logging/Kconfig.template.log_config"


menu "Main application configuration"

#config MAIN_ENABLE_SOMETHING
#	bool "Enable some feature in the main application"
#	default y

endmenu
```

## sample.yaml
```
# This file is provided so that the application can be compiled using Twister,
# the Zephyr testing tool. In this file, multiple combinations can be specified,
# so that you can easily test all of them locally or in CI.
sample:
  description: "{{ cookiecutter.project_name }}"
  name: "{{ cookiecutter.project_name_slug }}"
common:
  build_only: true
  integration_platforms:{% if cookiecutter.create_own_board %}
    - custom_plank{% endif %}
    - nrf52840dongle
tests:
  app.default: {}
  app.debug:
    extra_overlay_confs:
      - debug.conf
```

## prj.conf
```kconfig
# Copyright (c) {% now 'utc', '%Y' %} {{cookiecutter.project_org}}
# Copyright (c) 2021 Nordic Semiconductor ASA
# SPDX-License-Identifier: Apache-2.0
#
# This file contains selected Kconfig options for the application.
# See https://docs.zephyrproject.org/latest/kconfig.html for all possible options.

# Shell & Logging
CONFIG_PRINTK=y
CONFIG_SHELL=y
CONFIG_LOG=y
CONFIG_KERNEL_SHELL=y
CONFIG_DEVICE_SHELL=y

{% if cookiecutter.create_own_driver %}
#CONFIG_SENSOR=y
#CONFIG_BLINK=y{% else %}
#CONFIG_GPIO=y{% endif %}

# TODO
```

## debug.conf
```kconfig
# Copyright (c) {% now 'utc', '%Y' %} {{cookiecutter.project_org}}
# Copyright (c) 2021 Nordic Semiconductor ASA
# SPDX-License-Identifier: Apache-2.0
#
# This is a Kconfig fragment which can be used to enable debug-related options
# in the application. See the README for more details.

# Compiler
CONFIG_DEBUG_OPTIMIZATIONS=y

# Logging
CONFIG_APP_LOG_LEVEL_DBG=y
```

## boards/native_sim.conf
```kconfig
#CONFIG_GPIO_EMUL=y
```

## boards/native_sim.overlay
```dts
/*
 * Copyright (c) {% now 'utc', '%Y' %} {{cookiecutter.project_org}}
 * Copyright (c) 2021 Nordic Semiconductor ASA
 * SPDX-License-Identifier: Apache-2.0
 */

/* This devicetree overlay file will be automatically picked by the Zephyr
 * build system when building the sample for the nucleo_f302r8 board. It shows
 * how the example-application can be built on sample boards already provided
 * by Zephyr.
 */

/ {
	// TODO
};
```

## src/main.c
```c
/*
 * Copyright (c) {% now 'utc', '%Y' %} {{cookiecutter.project_org}}
 * Copyright (c) 2021 Nordic Semiconductor ASA
 * SPDX-License-Identifier: Apache-2.0
 */

#include <zephyr/kernel.h>
#include <zephyr/logging/log.h>

#include <app_version.h>

LOG_MODULE_REGISTER(main, CONFIG_APP_LOG_LEVEL);

int main(void)
{
	printk("{{ cookiecutter.project_name }} %s\n", APP_VERSION_STRING);

	printk("You've reached main()\n");
	// TODO

	return 0;
}
```
