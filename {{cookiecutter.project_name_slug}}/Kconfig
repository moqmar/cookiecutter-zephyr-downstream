## {{cookiecutter.project_name_slug}}/boards/vendor/custom_plank/Kconfig.custom_plank
```kconfig
# Copyright (c) {% now 'utc', '%Y' %} {{cookiecutter.project_org}}
# Copyright (c) 2021 Nordic Semiconductor ASA
# SPDX-License-Identifier: Apache-2.0

config BOARD_CUSTOM_PLANK
	select SOC_NRF52840_QIAA
```

## {{cookiecutter.project_name_slug}}/boards/vendor/custom_plank/board.yml
```yaml
# Copyright (c) {% now 'utc', '%Y' %} {{cookiecutter.project_org}}
# Copyright (c) 2024 Nordic Semiconductor ASA
# SPDX-License-Identifier: Apache-2.0

board:
  name: custom_plank
  vendor: vendor
  socs:
    - name: nrf52840
```

## {{cookiecutter.project_name_slug}}/drivers/Kconfig
```kconfig
# Copyright (c) {% now 'utc', '%Y' %} {{cookiecutter.project_org}}
# Copyright (c) 2021 Nordic Semiconductor ASA
# SPDX-License-Identifier: Apache-2.0

menu "Downstream drivers"
rsource "blink/Kconfig"
endmenu
```

## {{cookiecutter.project_name_slug}}/drivers/sensor/Kconfig
```kconfig
# Copyright (c) {% now 'utc', '%Y' %} {{cookiecutter.project_org}}
# Copyright (c) 2021 Nordic Semiconductor ASA
# SPDX-License-Identifier: Apache-2.0

if SENSOR
rsource "example_sensor/Kconfig"
endif # SENSOR
```

## {{cookiecutter.project_name_slug}}/tests/lib/custom/testcase.yaml
```yaml
common:
  tags: extensibility
  integration_platforms:{% if cookiecutter.create_own_board %}
    - custom_plank{% endif %}
    - qemu_cortex_m0
tests:
  lib.custom: {}
  lib.custom.non_default:
    extra_args: CONFIG_CUSTOM_GET_VALUE_DEFAULT=6
```

## {{cookiecutter.project_name_slug}}/west.yml
```yaml
# Copyright (c) {% now 'utc', '%Y' %} {{cookiecutter.project_org}}
# Copyright (c) 2021 Nordic Semiconductor ASA
# SPDX-License-Identifier: Apache-2.0

manifest:
{% if cookiecutter.create_own_west_command %}  self:
    west-commands: scripts/west-commands.yml
{% endif %}
  remotes:
    - name: zephyrproject-rtos
      url-base: https://github.com/zephyrproject-rtos

  projects:
    - name: zephyr
      remote: zephyrproject-rtos
      revision: v4.2.0
      import:
        # By using name-allowlist we can clone only the modules that are
        # strictly needed by the application.
        name-allowlist:
          - cmsis_6    # required by the ARM port for Cortex-M
          - hal_nordic # required by the custom_plank board (Nordic based)
          - hal_stm32  # required by the nucleo_f302r8 board (STM32 based)
```
