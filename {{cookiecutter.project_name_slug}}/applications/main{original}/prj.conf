## CMakeLists.txt
```
#-------------------------------------------------------------------------------
# Zephyr Example Application
#
# Copyright (c) {% now 'utc', '%Y' %} {{cookiecutter.project_org}}
# Copyright (c) 2021 Nordic Semiconductor ASA
# SPDX-License-Identifier: Apache-2.0

cmake_minimum_required(VERSION 3.13.1)
find_package(Zephyr REQUIRED HINTS $ENV{ZEPHYR_BASE})

project(app LANGUAGES C)

target_sources(app PRIVATE src/main.c)
```

## Kconfig
```
# Copyright (c) {% now 'utc', '%Y' %} {{cookiecutter.project_org}}
# Copyright (c) 2021 Nordic Semiconductor ASA
# SPDX-License-Identifier: Apache-2.0
#
# This file is the application Kconfig entry point. All application Kconfig
# options can be defined here or included via other application Kconfig files.
# You can browse these options using the west targets menuconfig (terminal) or
# guiconfig (GUI).

menu "Zephyr"
source "Kconfig.zephyr"
endmenu

module = APP
module-str = APP
source "subsys/logging/Kconfig.template.log_config"
```

## sample.yaml
```
# This file is provided so that the application can be compiled using Twister,
# the Zephyr testing tool. In this file, multiple combinations can be specified,
# so that you can easily test all of them locally or in CI.
sample:
  description: "{{ cookiecutter.project_name }}"
  name: "{{ cookiecutter.project_name_slug }}"
common:
  build_only: true
  integration_platforms:{% if cookiecutter.create_own_board %}
    - custom_plank{% endif %}
    - nucleo_f302r8
tests:
  app.default: {}
  app.debug:
    extra_overlay_confs:
      - debug.conf
```

## prj.conf
```kconfig
# Copyright (c) {% now 'utc', '%Y' %} {{cookiecutter.project_org}}
# Copyright (c) 2021 Nordic Semiconductor ASA
# SPDX-License-Identifier: Apache-2.0
#
# This file contains selected Kconfig options for the application.
# See https://docs.zephyrproject.org/latest/kconfig.html for all possible options.
{% if cookiecutter.create_own_driver %}
CONFIG_SENSOR=y
CONFIG_BLINK=y{% else %}
CONFIG_GPIO=y{% endif %}
```

## boards/nucleo_f302r8.overlay
```dts
/*
 * Copyright (c) {% now 'utc', '%Y' %} {{cookiecutter.project_org}}
 * Copyright (c) 2021 Nordic Semiconductor ASA
 * SPDX-License-Identifier: Apache-2.0
 */

/* This devicetree overlay file will be automatically picked by the Zephyr
 * build system when building the sample for the nucleo_f302r8 board. It shows
 * how the example-application can be built on sample boards already provided
 * by Zephyr.
 */

/ {
	{% if cookiecutter.create_own_driver %}example_sensor: example-sensor {
		compatible = "zephyr,example-sensor";
		input-gpios = <&gpioc 13 (GPIO_PULL_UP | GPIO_ACTIVE_LOW)>;
	};

	blink_led: blink-led {
		compatible = "blink-gpio-led";
		led-gpios = <&gpiob 13 GPIO_ACTIVE_HIGH>;
		blink-period-ms = <1000>;
	};{% else %}leds {
		compatible = "gpio-leds";

		blink_led: blink_led {
			gpios = <&gpiob 13 GPIO_ACTIVE_HIGH>;
			label = "User LED";
		};
	};{% endif %}
};

&gpioc {
	status = "okay";
};
```

## src/main.c
```c
/*
 * Copyright (c) {% now 'utc', '%Y' %} {{cookiecutter.project_org}}
 * Copyright (c) 2021 Nordic Semiconductor ASA
 * SPDX-License-Identifier: Apache-2.0
 */

#include <zephyr/kernel.h>{% if cookiecutter.create_own_driver %}
#include <zephyr/drivers/sensor.h>
#include <zephyr/logging/log.h>

#include <app/drivers/blink.h>{% else %}
#include <zephyr/drivers/gpio.h>
#include <zephyr/logging/log.h>{% endif %}

#include <app_version.h>

LOG_MODULE_REGISTER(main, CONFIG_APP_LOG_LEVEL);
{% if cookiecutter.create_own_driver %}
#define BLINK_PERIOD_MS_STEP 100U
#define BLINK_PERIOD_MS_MAX  1000U
{% endif %}
int main(void)
{
	int ret;
{% if cookiecutter.create_own_driver %}	unsigned int period_ms = BLINK_PERIOD_MS_MAX;
	const struct device *sensor, *blink;
	struct sensor_value last_val = { 0 }, val;
{% else %}
	const struct gpio_dt_spec led_gpios = GPIO_DT_SPEC_GET(DT_NODELABEL(blink_led), gpios);
{% endif %}
	printk("{{ cookiecutter.project_name }} %s\n", APP_VERSION_STRING);
{% if cookiecutter.create_own_driver %}
	sensor = DEVICE_DT_GET(DT_NODELABEL(example_sensor));
	if (!device_is_ready(sensor)) {
		LOG_ERR("Sensor not ready");
		return 0;
	}

	blink = DEVICE_DT_GET(DT_NODELABEL(blink_led));
	if (!device_is_ready(blink)) {
		LOG_ERR("Blink LED not ready");
		return 0;
	}

	ret = blink_off(blink);
	if (ret < 0) {
		LOG_ERR("Could not turn off LED (%d)", ret);
		return 0;
	}

	printk("Use the sensor to change LED blinking period\n");

	while (1) {
		ret = sensor_sample_fetch(sensor);
		if (ret < 0) {
			LOG_ERR("Could not fetch sample (%d)", ret);
			return 0;
		}

		ret = sensor_channel_get(sensor, SENSOR_CHAN_PROX, &val);
		if (ret < 0) {
			LOG_ERR("Could not get sample (%d)", ret);
			return 0;
		}

		if ((last_val.val1 == 0) && (val.val1 == 1)) {
			if (period_ms == 0U) {
				period_ms = BLINK_PERIOD_MS_MAX;
			} else {
				period_ms -= BLINK_PERIOD_MS_STEP;
			}

			printk("Proximity detected, setting LED period to %u ms\n",
				   period_ms);
			blink_set_period_ms(blink, period_ms);
		}

		last_val = val;

		k_sleep(K_MSEC(100));
	}
{% else %}
	if (!gpio_is_ready_dt(&led_gpios)) {
		LOG_ERR("LED not ready");
		return 0;
	}

	ret = gpio_pin_configure_dt(&led_gpios, GPIO_OUTPUT_ACTIVE);
	if (ret < 0) {
		LOG_ERR("LED not configured (%d)", ret);
		return 0;
	}

	while (true) {
		ret = gpio_pin_toggle_dt(&led_gpios);
		if (ret < 0) {
			LOG_ERR("LED not toggled (%d)", ret);
			return 0;
		}
		k_msleep(250);
	}
{% endif %}
	return 0;
}
```
